// Copyright (c) 2004-2020 Microchip Technology Inc. and its subsidiaries.
// SPDX-License-Identifier: MIT

/dts-v1/;
/plugin/;

/ {
        fragment@0 {
		target-path = "/";
		__overlay__ {
			meba {
				board = "EVB-LAN9698-10SFP";
				pcb = "0x8422";
				type = "0";
				target = "0x969C"; //Laguna-100-RED
			};
		};
	};
};
