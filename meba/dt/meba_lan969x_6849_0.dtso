// Copyright (c) 2004-2020 Microchip Technology Inc. and its subsidiaries.
// SPDX-License-Identifier: MIT

/dts-v1/;
/plugin/;

/ {
        fragment@0 {
		target-path = "/";
		__overlay__ {
			meba {
				board = "FPGA-LAN9698X-Sunrise";
				pcb = "0x6849";
				type = "0";
				target = "0x969C";
			};
		};
	};
};
