## mepa/src/intel/GPY_API_v251/Kconfig
```kconfig
#
# Phy drivers for Lantiq / Intel platforms
#
config INTEL_GPY211_PHY
	tristate "Intel GPY211 PHY driver"
	default y
	help
	  Support for Intel GPY211 PHY platform.
```
